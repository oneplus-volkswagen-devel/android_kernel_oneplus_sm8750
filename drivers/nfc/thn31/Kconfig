## drivers/nfc/thn31/Kconfig
```kconfig
#
# TMS devices
#

menu "TMS devices support"

config TMS_NFC_DEVICE
    tristate "TMS NFC Driver"
    depends on I2C
    help
        Say Y here if you have I2C device.

config TMS_ESE_DEVICE
    tristate "TMS ESE Driver"
    depends on SPI
    help
        Say Y here if you have SPI device.

endmenu
```
